## dts/bindings/zmk,vfx-layer-twinkle.yaml
```yaml
# Copyright (c) 2026 The ZMK VFX Contributors
# SPDX-License-Identifier: MIT

description: |
  Scattered pixels fade up and out at random.
  Which pixels twinkle is derived from a hash of the pixel and the cycle
  number rather than stored, so both halves of a split agree without
  exchanging anything and nothing accumulates between frames.

compatible: "zmk,vfx-layer-twinkle"

include: vfx-layer-common.yaml

properties:
  color:
    type: int
    required: true
    description: |
      Packed color, built with VFX_HSB(h, s, b).
  period-ms:
    type: int
    default: 1200
    description: |
      Lifetime of a single twinkle, in milliseconds.
  density:
    type: int
    default: 40
    description: |
      0-255, roughly the fraction of pixels lit at any moment.
```

## dts/bindings/zmk,vfx-layer-water.yaml
```yaml
# Copyright (c) 2026 The ZMK VFX Contributors
# SPDX-License-Identifier: MIT

description: |
  A rippling water surface.

  Each drop sends out a decaying wavetrain, and overlapping drops sum as
  signed surface height before being coloured, so they interfere the way real
  ripples do rather than drawing as separate rings.

  Drops come from two places, and both can run at once:

    - ambient rain, set by drop-rate-ms, derived from the clock so both
      halves of a split agree without exchanging anything;
    - keypresses, which drop into the surface where the key sits.

  Set drop-rate-ms to 0 for a purely reactive surface. With a low-brightness
  color the still water draws nothing, so it layers over other effects.

  Reactive placement needs key-pixels on the engine node; without it key
  positions are spread evenly over the strip.

compatible: "zmk,vfx-layer-water"

include: vfx-layer-common.yaml

properties:
  color:
    type: int
    required: true
    description: |
      Still water, built with VFX_HSB(h, s, b). Troughs darken toward black
      from here. A brightness of 0 means still water draws nothing, which is
      what you want when layering this over something else.

  crest-color:
    type: int
    default: 0
    description: |
      Colour at the top of a wave. 0 simply brightens `color` instead, which
      is flatter looking; giving crests their own colour is what produces
      highlights on the surface.

  wavelength:
    type: int
    default: 8
    description: Virtual pixels per wave cycle. Larger is a longer, lazier swell.

  speed:
    type: int
    default: 30
    description: |
      Virtual pixels per second the wavefront travels, scaled by the engine's
      global speed setting.

  lifetime-ms:
    type: int
    default: 2500
    description: How long one drop keeps rippling before the surface settles.

  drop-rate-ms:
    type: int
    default: 0
    description: |
      Milliseconds between ambient drops. 0 leaves only keypress drops.
      Values near lifetime-ms give occasional drops; much smaller values give
      continuous rain.

  amplitude:
    type: int
    default: 200
    description: 0-255, how far the waves move the surface from its resting colour.

  damping:
    type: int
    default: 8
    description: |
      How quickly a wave loses height with distance from its drop. A wave
      falls to half height after roughly 256/damping pixels, so 8 carries
      across a 36 pixel half and 32 keeps ripples close to where they landed.
      0 lets them cross the whole board undiminished.
```

## dts/bindings/zmk,vfx-layer-wave.yaml
```yaml
# Copyright (c) 2026 The ZMK VFX Contributors
# SPDX-License-Identifier: MIT

description: |
  A travelling sine along the strip, modulating brightness.
  Unlike a scrolling gradient this keeps one color and varies its level.

compatible: "zmk,vfx-layer-wave"

include: vfx-layer-common.yaml

properties:
  color:
    type: int
    required: true
    description: |
      Packed color, built with VFX_HSB(h, s, b).
  wavelength:
    type: int
    default: 0
    description: |
      Axis units per cycle. 0 fits exactly one cycle to the board. Units follow
      the axis, as for the gradient's span.
  period-ms:
    type: int
    default: 2000
    description: |
      Milliseconds for the wave to travel one wavelength.
  depth:
    type: int
    default: 255
    description: |
      0-255. 0 leaves the color flat, 255 takes the trough to black.

  axis:
    type: int
    default: 0
    description: |
      Which way it runs across the board: VFX_AXIS_STRIP (along the wire, the
      default), VFX_AXIS_X, VFX_AXIS_Y, VFX_AXIS_RADIAL (out from the middle),
      VFX_AXIS_ANGLE (around it) or VFX_AXIS_SPIRAL.

      Everything but VFX_AXIS_STRIP needs pixel-positions on the engine node.
      Without a map there is no board to run across, so they all fall back to
      the strip rather than going dark.
```

## dts/bindings/zmk,vfx-layer-wpm.yaml
```yaml
# Copyright (c) 2026 The ZMK VFX Contributors
# SPDX-License-Identifier: MIT

description: |
  Colours the zone by how fast you are typing, or fills it as a bar.

  Needs CONFIG_ZMK_WPM=y, which is what computes the estimate. Without it the
  reading stays at zero and the layer sits at its idle colour.

compatible: "zmk,vfx-layer-wpm"

include: vfx-layer-common.yaml

properties:
  idle-color:
    type: int
    required: true
    description: |
      At rest, built with VFX_HSB(h, s, b). Brightness 0 makes the layer draw
      nothing while you are not typing, which lets the power gate cut the rail.

  fast-color:
    type: int
    required: true
    description: At `full` words per minute and above.

  full:
    type: int
    default: 80
    description: |
      The words per minute that counts as flat out. Set it near your own top
      speed, or the colour spends all its time at the slow end.

  bar:
    type: int
    default: 0
    description: |
      Non-zero fills the zone in proportion to speed instead of colouring all
      of it, the way the battery indicator fills.
```

## dts/bindings/zmk,vfx-scene.yaml
```yaml
# Copyright (c) 2026 The ZMK VFX Contributors
# SPDX-License-Identifier: MIT

description: |
  A stack of effect layers. Child nodes are the layers, composited in
  devicetree order: the first child is the bottom of the stack.

compatible: "zmk,vfx-scene"

properties:
  display-name:
    type: string
    description: Name shown in ZMK Studio and in the simulator.
```

## dts/bindings/zmk,vfx-zone.yaml
```yaml
# Copyright (c) 2026 The ZMK VFX Contributors
# SPDX-License-Identifier: MIT

description: |
  A named group of pixels that a layer can be scoped to. Give exactly one of
  range, pixels or keys.

compatible: "zmk,vfx-zone"

properties:
  range:
    type: array
    default: [0, 0]
    description: |
      Two cells, <first-index count>. Defaulted so that a zone using the
      pixels property still has this defined; the instantiation macros read
      whichever one applies.

  pixels:
    type: array
    description: Explicit pixel indices, for zones that are not contiguous.

  keys:
    type: array
    description: |
      Key positions, as the keymap numbers them. The engine turns them into
      pixel indices at startup using key-pixels, so "the modifiers" or "the
      home row" can be written as what it is rather than as LED indices read
      off a wiring diagram -- and it stays correct if the strip is rerouted.

      On a split, both halves are given the same list and each keeps only the
      keys whose pixel lands on its own strip, so one zone definition covers
      the whole board.
```
