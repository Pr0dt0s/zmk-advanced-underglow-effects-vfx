## dts/bindings/zmk,vfx-layer-pulse.yaml
```yaml
# Copyright (c) 2026 The ZMK VFX Contributors
# SPDX-License-Identifier: MIT

description: |
  Lifts the whole zone on a keypress and lets it fall back, without caring
  which key was pressed.

  Every other reactive generator places itself against the pressed key, which
  only means anything when the pixels sit under the keys. Underglow is behind
  the board, so the useful reading of a press there is that one happened at
  all: the zone answers as one.

  With min-level at 0 the zone is black between presses, so a scene built only
  from this draws nothing at rest and the power gate can cut the rail until
  the next keystroke.

compatible: "zmk,vfx-layer-pulse"

include: vfx-layer-common.yaml

properties:
  color:
    type: int
    required: true
    description: Packed VFX_HSB() the zone lights up in.

  decay-ms:
    type: int
    default: 500
    description: |
      Time from a press back down to min-level. Shorter reads as a blink,
      longer as a swell. 0 holds the level indefinitely.

  min-level:
    type: int
    default: 0
    description: |
      0-255 floor the zone never falls below, so the effect can sit as a dim
      wash that brightens as you type rather than going dark between presses.
      Leaving it at 0 is what lets the power gate cut.

  hue-step:
    type: int
    default: 0
    description: |
      Degrees the hue advances on each press, so a run of typing walks the
      colour wheel. 0 keeps the colour fixed.

  stack:
    type: boolean
    description: |
      Presses add to the current level instead of restarting it from full, so
      typing faster than the decay builds up rather than pinning at maximum
      from the first key.
```

## dts/bindings/zmk,vfx-layer-ripple.yaml
```yaml
# Copyright (c) 2026 The ZMK VFX Contributors
# SPDX-License-Identifier: MIT

description: |
  Expanding rings radiating from each pressed key.

  Needs the engine's key-pixels property to know where a key sits on the
  strip; without it, key positions are spread evenly over the board,
  which still animates but will not line up with the keys.

compatible: "zmk,vfx-layer-ripple"

include: vfx-layer-common.yaml

properties:
  color:
    type: int
    required: true
    description: |
      Packed color, built with VFX_HSB(h, s, b).
  decay-ms:
    type: int
    default: 600
    description: |
      How long one ripple takes to fade out.
  speed:
    type: int
    default: 40
    description: |
      Virtual pixels per second the ripple front travels.
  width:
    type: int
    default: 3
    description: |
      Virtual pixels of the bright band at the front.
```

## dts/bindings/zmk,vfx-layer-solid.yaml
```yaml
# Copyright (c) 2026 The ZMK VFX Contributors
# SPDX-License-Identifier: MIT

description: Fills its zone with one color.

compatible: "zmk,vfx-layer-solid"

include: vfx-layer-common.yaml

properties:
  color:
    type: int
    required: true
    description: Packed color, built with VFX_HSB(h, s, b).
```

## dts/bindings/zmk,vfx-layer-static.yaml
```yaml
# Copyright (c) 2026 The ZMK VFX Contributors
# SPDX-License-Identifier: MIT

description: |
  Independent randomness per pixel, re-rolled on a clock.

  Twinkle carries a fade envelope and plasma is a smooth field, so neither can
  be tuned into this: what is missing from both is pixels that have nothing to
  do with their neighbours or with what they were a moment ago.

  Like the other ambient generators it holds no state, deriving each roll from
  the time and the pixel index, which is what keeps the two halves of a split
  showing the same field without exchanging anything.

compatible: "zmk,vfx-layer-static"

include: vfx-layer-common.yaml

properties:
  color:
    type: int
    required: true
    description: Packed VFX_HSB() the field is drawn in.

  period-ms:
    type: int
    default: 90
    description: |
      How often the field is re-rolled. Short enough reads as noise, long
      enough reads as a pattern that keeps changing its mind.

  density:
    type: int
    default: 60
    description: |
      0-255 share of pixels lit in a roll. Low leaves a sparse scatter on
      black; high fills the board and the effect becomes its flicker.

  hue-spread:
    type: int
    default: 0
    description: |
      Degrees of hue jitter between pixels, so the field is not all one
      colour. 0 keeps every lit pixel on the colour given.
```
