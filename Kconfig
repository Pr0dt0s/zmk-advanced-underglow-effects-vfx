## dts/bindings/zmk,vfx-layer-dart.yaml
```yaml
# Copyright (c) 2026 The ZMK VFX Contributors
# SPDX-License-Identifier: MIT

description: |
  A keypress launches a packet of light that then travels along an axis.

  Ripple expands as a ring from where it started, and comet travels but runs
  on a timer and is never triggered, so a struck thing that then moves is not
  reachable by combining the two.

  Each dart starts from where its key sits along the axis, so a key at one end
  of the board throws from that end. On a short run of pixels, such as an
  underglow channel, every keystroke reads as a shot down the strip.

compatible: "zmk,vfx-layer-dart"

include: vfx-layer-common.yaml

# Distances are in the units pixel-positions uses: about 10 per LED on the
# shipped maps. Without a position map they are strip indices, so scale down.

properties:
  color:
    type: int
    required: true
    description: Packed VFX_HSB() of the body trailing the head.

  head-color:
    type: int
    required: true
    description: Packed VFX_HSB() of the leading point, usually paler.

  speed:
    type: int
    default: 90
    description: Axis units per second the dart travels.

  lifetime-ms:
    type: int
    default: 900
    description: |
      How long one dart lives, fading out across that time. Together with
      speed this sets how far it gets before it dies.

  tail:
    type: int
    default: 25
    description: Axis units of body trailing behind the head.

  axis:
    type: int
    default: 1
    description: |
      Which way a dart runs, using the VFX_AXIS_* constants from
      dt-bindings/zmk/vfx.h. Defaults to VFX_AXIS_X, across the board.
    enum: [0, 1, 2, 3, 4, 5]

  reverse:
    type: boolean
    description: Travel toward decreasing axis values instead of increasing.
```

## dts/bindings/zmk,vfx-layer-fire.yaml
```yaml
# Copyright (c) 2026 The ZMK VFX Contributors
# SPDX-License-Identifier: MIT

description: |
  A hot bed with flames licking up from it.

  The usual way to do fire is a heat buffer that cools and diffuses each
  frame. That is both state and a dependency on every previous frame, so a
  dropped frame changes the fire and the two halves of a split drift apart
  within seconds. This is a pure function of position and time instead: each
  flame's height wanders from a hash of its column and the current instant,
  interpolated so it drifts rather than steps. Both halves burn the same fire
  with nothing exchanged.

  It wants pixel-positions so it knows which way is up. Without a map it
  burns along the strip, which still flickers but will not line up with the
  board.

compatible: "zmk,vfx-layer-fire"

include: vfx-layer-common.yaml

properties:
  base-color:
    type: int
    required: true
    description: |
      The coolest part, at the bottom of a flame. Built with VFX_HSB(h, s, b).
      A deep red or orange.

  tip-color:
    type: int
    required: true
    description: |
      The hottest part, at the tip. A pale yellow against a red base is what
      makes it read as fire rather than as an orange gradient.

  period-ms:
    type: int
    default: 500
    description: |
      Milliseconds between flame shapes. Shorter is a more agitated fire.

  cell:
    type: int
    default: 12
    description: |
      Units across per flame, in pixel-positions units. Around one LED pitch
      gives a flame per column; larger merges columns into broader flames.

  height:
    type: int
    default: 200
    description: |
      0-255, how far up the board the flames reach at full stretch. 255 lets
      them cover it entirely.

  flicker:
    type: int
    default: 180
    description: |
      0-255, how much a flame's height varies. 0 is a steady glow of constant
      height; 255 is every flame independently wandering the full range.

  axis:
    type: int
    default: 2
    description: |
      Which way is up, as a VFX_AXIS_* value. VFX_AXIS_Y (the default) burns
      up the board. VFX_AXIS_RADIAL burns outward from the middle.
```

## dts/bindings/zmk,vfx-layer-flag.yaml
```yaml
# Copyright (c) 2026 The ZMK VFX Contributors
# SPDX-License-Identifier: MIT

description: |
  Lights its zone while a host lock LED is on, or while a modifier is held.

  Locks and modifiers are the same shape of thing -- a bit set somewhere and a
  colour to show for it -- so one generator reads either and `source` picks.

  A word on caps lock: a keyboard cannot know it by itself. Pressing the key
  is a request to the host, not a toggle, and the keyboard only learns the
  answer when the host sends an LED report back. So this needs
  CONFIG_ZMK_HID_INDICATORS=y, and on a split it only works on the central,
  which is the half ZMK compiles the HID code for.

  There is still no caps-word indicator: ZMK exposes neither a state accessor
  nor an event for that one, so it could not be driven on hardware.

compatible: "zmk,vfx-layer-flag"

include: vfx-layer-common.yaml

properties:
  color:
    type: int
    required: true
    description: |
      Shown while any of the masked bits is set, built with VFX_HSB(h, s, b).
      The layer draws nothing at all when they are clear, so it sits over
      another effect rather than blanking it.

  source:
    type: int
    default: 0
    description: |
      VFX_FLAG_LOCKS (the default) reads the host's lock LEDs;
      VFX_FLAG_MODIFIERS reads the modifiers currently held.

  mask:
    type: int
    default: 2
    description: |
      Which bits light the zone; any one of them is enough. Locks are
      VFX_LOCK_CAPS (the default), VFX_LOCK_NUM, VFX_LOCK_SCROLL,
      VFX_LOCK_COMPOSE and VFX_LOCK_KANA. Modifiers are VFX_MOD_CTRL,
      VFX_MOD_SHIFT, VFX_MOD_ALT and VFX_MOD_GUI, each covering both sides.
      Or them together for more than one.
```

## dts/bindings/zmk,vfx-layer-gradient.yaml
```yaml
# Copyright (c) 2026 The ZMK VFX Contributors
# SPDX-License-Identifier: MIT

description: |
  A cyclic multi-stop gradient across the virtual strip, optionally scrolling.
  Two stops of the same hue at different brightness gives a comet; a full set
  of hues gives a rainbow equivalent to ZMK's built-in swirl.

compatible: "zmk,vfx-layer-gradient"

include: vfx-layer-common.yaml

properties:
  stops:
    type: array
    required: true
    description: |
      Colors built with VFX_HSB(h, s, b). The gradient is cyclic, so the last
      stop blends back into the first. Interpolation takes the short way around
      the hue circle.

  scroll-speed:
    type: int
    default: 0
    description: |
      Axis units per second, scaled by the engine's global speed setting.
      Negative scrolls the other way. 0 holds the gradient still.

      Units follow the axis: strip position for VFX_AXIS_STRIP, pixel-positions
      units for X, Y and RADIAL, and 256ths of a turn for ANGLE and SPIRAL.

  span:
    type: int
    default: 0
    description: |
      Axis units covered by one full cycle of the gradient. 0 stretches one
      cycle across the board, whichever way it is pointing.

  axis:
    type: int
    default: 0
    description: |
      Which way it runs across the board: VFX_AXIS_STRIP (along the wire, the
      default), VFX_AXIS_X, VFX_AXIS_Y, VFX_AXIS_RADIAL (out from the middle),
      VFX_AXIS_ANGLE (around it) or VFX_AXIS_SPIRAL.

      Everything but VFX_AXIS_STRIP needs pixel-positions on the engine node.
      Without a map there is no board to run across, so they all fall back to
      the strip rather than going dark.
```

## dts/bindings/zmk,vfx-layer-hold.yaml
```yaml
# Copyright (c) 2026 The ZMK VFX Contributors
# SPDX-License-Identifier: MIT

description: |
  Lights the key you are holding, for exactly as long as you hold it.

  Every other reactive generator is struck and then decays on a schedule fixed
  at the moment of the press, which cannot express a duration that is not
  known yet when the key goes down. This is the only one that reads the
  release, and so the only way to show a held modifier, a held layer key, or
  a chord while it is being made.

  Needs the engine's key-pixels property to know which pixel a key sits
  under; without one the key positions are spread evenly and the wrong LED
  lights up.

compatible: "zmk,vfx-layer-hold"

include: vfx-layer-common.yaml

properties:
  color:
    type: int
    required: true
    description: Packed VFX_HSB() a held key lights up in.

  release-ms:
    type: int
    default: 220
    description: |
      Time to fade out after the key is let go. 0 cuts straight out, which
      reads as harsh at the speed people actually type.
```

## dts/bindings/zmk,vfx-layer-layer-state.yaml
```yaml
# Copyright (c) 2026 The ZMK VFX Contributors
# SPDX-License-Identifier: MIT

description: |
  Colors its zone according to the highest active keymap layer.
  List one color per layer, in layer order.

compatible: "zmk,vfx-layer-layer-state"

include: vfx-layer-common.yaml

properties:
  colors:
    type: array
    required: true
    description: |
      One packed color per keymap layer. A layer given a color with
      zero brightness draws nothing, which is the usual choice for the
      base layer so it stays out of the way.
```

## dts/bindings/zmk,vfx-layer-matrix.yaml
```yaml
# Copyright (c) 2026 The ZMK VFX Contributors
# SPDX-License-Identifier: MIT

description: |
  Matrix rain: columns of light falling down the board, each a bright head
  with a fading trail behind it.

  Drops come from two places, and both can run at once:

    - ambient rain, set by drop-rate-ms, hashed from the clock so both halves
      of a split agree on it without exchanging anything;
    - keypresses, which start a drop at the key you pressed so the reaction
      shows under your finger and then falls away from it.

  Set drop-rate-ms to 0 for keypress-only rain, which leaves the board dark
  between presses and lets the power gate cut the rail.

  This is the one generator that needs to know which way is down, so give the
  engine pixel-positions. Without a map it treats strip order as the direction
  of travel: still animated, but not falling down the board.

compatible: "zmk,vfx-layer-matrix"

include: vfx-layer-common.yaml

# Distances below are in the units pixel-positions uses. The shipped maps put
# about 10 units between adjacent LEDs and these defaults assume that.

properties:
  color:
    type: int
    required: true
    description: The trail, built with VFX_HSB(h, s, b). Classically a green.

  head-color:
    type: int
    default: 0
    description: |
      The leading pixel of a drop. 0 brightens `color` instead. A pale,
      desaturated head against a saturated trail is what makes rain read as
      falling rather than as a moving stripe.

  speed:
    type: int
    default: 60
    description: Units per second the head falls.

  tail:
    type: int
    default: 40
    description: |
      Units of trail behind the head. Around the height of the board gives
      continuous columns; much shorter gives distinct comets.

  drop-rate-ms:
    type: int
    default: 0
    description: |
      Milliseconds between ambient drops. 0 leaves only keypress drops.
      Smaller values give denser rain.

  columns:
    type: int
    default: 6
    description: |
      How many columns the board is divided into. Match it to the number of
      LED columns in your position map, or use fewer for wider bands.

  jitter:
    type: int
    default: 60
    description: |
      0-255, how much per-drop speeds vary. Without some spread the columns
      march in step, which reads as a sweep rather than as rain.

  head-size:
    type: int
    default: 8
    description: Units at the front of a drop drawn with head-color.
```

## dts/bindings/zmk,vfx-layer-peripheral-battery.yaml
```yaml
# Copyright (c) 2026 The ZMK VFX Contributors
# SPDX-License-Identifier: MIT

description: |
  The other half's battery, drawn the way zmk,vfx-layer-battery draws your own.

  This is the cell you cannot check by looking at the half in front of you,
  which is what makes it worth a separate indicator. Only the central hears
  about it, so it needs CONFIG_ZMK_SPLIT_BLE_CENTRAL_BATTERY_LEVEL_FETCHING=y
  and stays at unknown-color on a peripheral.

compatible: "zmk,vfx-layer-peripheral-battery"

include: vfx-layer-common.yaml

properties:
  high-color:
    type: int
    required: true
    description: A full cell. The bar is coloured between this and low-color.

  low-color:
    type: int
    required: true
    description: |
      An empty one, and the colour of the whole bar below warn-below.

  empty-color:
    type: int
    default: 0
    description: |
      The unfilled part of the zone. 0 draws nothing there, so whatever is
      underneath shows through.

  unknown-color:
    type: int
    default: 0
    description: |
      Before the peripheral has ever reported. Not the same as a flat cell,
      and worth its own colour rather than an alarming empty bar. 0 draws
      nothing until the first report arrives.

  source:
    type: int
    default: 0
    description: Which peripheral, 0 based. A two-piece split has only 0.

  warn-below:
    type: int
    default: 20
    description: Percent under which the whole bar turns low-color.
```

## dts/bindings/zmk,vfx-layer-plasma.yaml
```yaml
# Copyright (c) 2026 The ZMK VFX Contributors
# SPDX-License-Identifier: MIT

description: |
  Two sine waves at different rates, summed, driving a hue swing around
  the base color. Reads as slow organic movement rather than a sweep.

compatible: "zmk,vfx-layer-plasma"

include: vfx-layer-common.yaml

properties:
  color:
    type: int
    required: true
    description: |
      Packed color, built with VFX_HSB(h, s, b).
  scale:
    type: int
    default: 0
    description: |
      Units per cycle of the first wave. 0 fits one across the board.

      With pixel-positions the plasma is summed over both board axes, which is
      what makes the cells drift around each other. Without a map both axes
      collapse onto the strip and it degrades to a pair of travelling waves.
  period-ms:
    type: int
    default: 6000
    description: |
      Milliseconds per cycle of the animation.
  hue-spread:
    type: int
    default: 40
    description: |
      Degrees of hue swing either side of the base color.
```
