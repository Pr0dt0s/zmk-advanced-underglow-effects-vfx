## dts/bindings/vfx-layer-common.yaml
```yaml
# Copyright (c) 2026 The ZMK VFX Contributors
# SPDX-License-Identifier: MIT

# Included by every zmk,vfx-layer-* binding.

properties:
  zone:
    type: phandle
    required: true
    description: The zmk,vfx-zone this layer is allowed to draw into.

  blend:
    type: int
    default: 0
    description: |
      How this layer combines with what is already composited beneath it. Use
      the VFX_BLEND_* constants from dt-bindings/zmk/vfx.h.
    enum: [0, 1, 2, 3, 4]

  opacity:
    type: int
    default: 255
    description: |
      Layer opacity, 0-255. A layer at 0 is skipped entirely. With an
      opacity-source set this becomes the value reached at full signal rather
      than a constant.

  opacity-source:
    type: int
    default: 0
    description: |
      Let something the keyboard already knows drive how strongly this layer
      shows, using the VFX_SRC_* constants from dt-bindings/zmk/vfx.h:
      typing speed, charge remaining, or whether anyone is at the keyboard.

      This is how an ordinary generator becomes responsive without being
      rewritten. A fire whose opacity follows VFX_SRC_WPM banks up as you type
      and dies back when you stop, and it is still the same fire.

      Left at VFX_SRC_NONE the layer holds whatever opacity says.
    enum: [0, 1, 2, 3]

  opacity-min:
    type: int
    default: 0
    description: |
      Opacity when the signal reads zero, so a driven layer can fade toward
      dim rather than all the way out. Ignored without an opacity-source.

  opacity-full:
    type: int
    default: 0
    description: |
      Signal value at which the layer reaches its full opacity: words per
      minute for VFX_SRC_WPM, percent for VFX_SRC_BATTERY. 0 means 255, which
      suits percentages and is far too high for a WPM, so set it there.

      VFX_SRC_ACTIVITY ignores this, being a yes or no rather than a reading.

  tune-id:
    type: int
    default: 0
    description: |
      Opt this layer into being adjusted while the keyboard runs, by hue,
      level and speed, under the slot number given. 0, the default, means it
      cannot be, and it is then used exactly as written here.

      Layers sharing an id move together, which is how a scene built from
      several of them dims as one thing rather than in pieces.

      Everything else on a layer is fixed in flash by devicetree and cannot be
      written to at all; these three are the handles a running keyboard has.
      Slots run from 1 to VFX_TUNE_SLOTS - 1.
```

## dts/bindings/zmk,vfx-channel.yaml
```yaml
# Copyright (c) 2026 The ZMK VFX Contributors
# SPDX-License-Identifier: MIT

description: |
  A slice of the strip with its own scene list and its own scene, brightness,
  speed and hue, so that one part of a board can run a different effect from
  another rather than the whole strip sharing one.

  The usual reason is a board whose underglow and per-key LEDs sit on the same
  chain: they light different things and want different effects, and only a
  channel lets them be controlled apart.

    vfx_engine {
        glow: channel-glow {
            compatible = "zmk,vfx-channel";
            range = <0 6>;
            scenes = <&vfx_breathe &vfx_solid_warm &vfx_aurora>;
            default-scene = <&vfx_breathe>;
        };

        keys: channel-keys {
            compatible = "zmk,vfx-channel";
            range = <6 29>;
            scenes = <&vfx_reactive &vfx_matrix &vfx_crosshair>;
        };
    };

  A channel's id is its position in the devicetree, and that id is what the
  &vfx behavior's VFX_*_ON() macros address. Both halves of a split must
  declare the same channels carrying the same scenes in the same order:
  relative commands are resolved to an absolute index on the central and
  relayed as a number, so halves that disagree will not land on the same scene.

  Declaring no channel at all leaves the whole strip as a single channel
  showing every scene, which is how a board that has never heard of channels
  keeps working.

compatible: "zmk,vfx-channel"

properties:
  range:
    type: array
    required: true
    description: |
      Start and length in pixels, <start len>, as local indices into this
      half's own strip rather than into the virtual whole-board space. An
      over-long length is clamped to the chain, so 255 means "to the end".

  scenes:
    type: phandles
    required: true
    description: |
      The scenes this channel cycles, in order. Next and previous move within
      this list, and selecting by index indexes it, so a channel only ever
      shows scenes that make sense on the pixels it owns.

  default-scene:
    type: phandle
    description: |
      Scene shown on first boot, before any saved setting. Defaults to the
      first entry in scenes. Must be one of them.
```

## dts/bindings/zmk,vfx-engine.yaml
```yaml
# Copyright (c) 2026 The ZMK VFX Contributors
# SPDX-License-Identifier: MIT

description: |
  Advanced underglow effect engine. Owns the strip named by the zmk,underglow
  chosen node and renders scenes onto it.

compatible: "zmk,vfx-engine"

properties:
  fps:
    type: int
    description: |
      Target frame rate. Defaults to CONFIG_ZMK_VFX_FPS. The engine never
      renders faster than this and drops to an idle heartbeat when the active
      scene reports it has nothing left to animate.

  virtual-length:
    type: int
    description: |
      Pixel count of the whole keyboard, across both halves of a split. Effects
      are positioned in this space so a gradient flows continuously across the
      seam. Defaults to this half's chain-length.

  strip-offset:
    type: int
    default: 0
    description: |
      Index of this half's first pixel within virtual-length. Set 0 on the left
      half and the left half's pixel count on the right.

  default-scene:
    type: phandle
    description: Scene selected on first boot, before any saved setting.

  layer-scenes:
    type: phandles
    description: |
      A scene per keymap layer, indexed by layer number, so changing layer
      changes the whole lighting rather than one indicator strip:

        layer-scenes = <&vfx_warm &vfx_matrix &vfx_status>;

      Layers past the end of the list have no scene of their own and leave
      whatever is showing alone, so you can map only the ones you care about.

      This follows the active layer and is not saved: it would otherwise
      overwrite the scene chosen with the &vfx behavior. On a split it works
      on the central only, since that is the half with a keymap.

  transition-ms:
    type: int
    default: 0
    description: |
      Milliseconds to crossfade over when the scene changes. 0 cuts straight
      across, which is what it did before this existed.

      Both scenes render for the duration, so the cost is one extra frame's
      work and one extra frame buffer while a fade is running, and nothing at
      all when one is not.

  pixel-positions:
    type: array
    description: |
      Where each pixel physically sits, as x,y pairs across the whole board:
      <x0 y0 x1 y1 ...>, virtual-length pairs in total. Both halves of a split
      give the same full-board list; strip-offset selects this half's slice.

      Without it the engine knows only a pixel's position along the wire, so
      anything that radiates (water, ripple, keyflash, trail) spreads to
      whichever LEDs are adjacent on the strip. On a serpentine strip those
      are scattered across the board, which is why a ripple looks like it
      jumps around instead of expanding. Matrix needs it for a different
      reason: without a y axis it has no idea which way is down, and falls
      along the strip in a single column.

      Units are yours to choose; distances in effect properties are in the
      same ones. Roughly 10 per LED spacing works well: it leaves sub-LED
      resolution so wavefronts move smoothly, while keeping the numbers small.
      <vfx/lily58-positions.dtsi> follows that convention.

      Gradients, waves and the indicators are unaffected: those are meant to
      follow the strip.

  key-pixels:
    type: array
    description: |
      Pixel index nearest each key position, indexed by key position. Reactive
      effects use it to place a ripple. Omit for a linear key-to-pixel mapping.
```

## dts/bindings/zmk,vfx-layer-battery.yaml
```yaml
# Copyright (c) 2026 The ZMK VFX Contributors
# SPDX-License-Identifier: MIT

description: |
  Fills a fraction of its zone in proportion to battery charge.
  On a split each half reports its own battery, so a zone on each side
  shows that side's cell.

compatible: "zmk,vfx-layer-battery"

include: vfx-layer-common.yaml

properties:
  high-color:
    type: int
    required: true
    description: |
      Color of the filled portion at a healthy charge.
  low-color:
    type: int
    required: true
    description: |
      Color of the filled portion at or below warn-below.
  empty-color:
    type: int
    default: 0
    description: |
      Color of the unfilled portion. Zero brightness leaves it to
      whatever is underneath.
  warn-below:
    type: int
    default: 20
    description: |
      Percent at or below which low-color is used.
```

## dts/bindings/zmk,vfx-layer-ble-profile.yaml
```yaml
# Copyright (c) 2026 The ZMK VFX Contributors
# SPDX-License-Identifier: MIT

description: |
  One pixel per Bluetooth profile, lighting the selected one.
  The zone's length decides how many profile slots are shown.

compatible: "zmk,vfx-layer-ble-profile"

include: vfx-layer-common.yaml

properties:
  connected-color:
    type: int
    required: true
    description: |
      Selected profile, connected.
  disconnected-color:
    type: int
    required: true
    description: |
      Selected profile, not connected.
  usb-color:
    type: int
    default: 0
    description: |
      Shown instead when output is USB rather than Bluetooth.
```

## dts/bindings/zmk,vfx-layer-breathe.yaml
```yaml
# Copyright (c) 2026 The ZMK VFX Contributors
# SPDX-License-Identifier: MIT

description: |
  Pulses its zone between a floor and the full color.
  Equivalent to ZMK's built-in breathe effect, but the floor means it
  need not dip all the way to black.

compatible: "zmk,vfx-layer-breathe"

include: vfx-layer-common.yaml

properties:
  color:
    type: int
    required: true
    description: |
      Packed color, built with VFX_HSB(h, s, b).
  period-ms:
    type: int
    default: 4000
    description: |
      Milliseconds for one full in-and-out cycle at speed 3.
      The engine's speed setting scales this.
  min-level:
    type: int
    default: 0
    description: |
      0-255 floor. 0 breathes to black; raise it to keep the zone lit
      throughout, which also keeps the power gate from firing.
```

## dts/bindings/zmk,vfx-layer-caps-word.yaml
```yaml
# Copyright (c) 2026 The ZMK VFX Contributors
# SPDX-License-Identifier: MIT

description: |
  Lights its zone while caps word is active, optionally pulsing.

compatible: "zmk,vfx-layer-caps-word"

include: vfx-layer-common.yaml

properties:
  color:
    type: int
    required: true
    description: |
      Packed color, built with VFX_HSB(h, s, b).
  period-ms:
    type: int
    default: 0
    description: |
      Pulse period. 0 holds a steady color, which also lets the engine
      park its timer instead of rendering continuously.
```

## dts/bindings/zmk,vfx-layer-comet.yaml
```yaml
# Copyright (c) 2026 The ZMK VFX Contributors
# SPDX-License-Identifier: MIT

description: |
  A bright head running round the board with a fading tail.

  Matrix rain is the same idea with drops that start and stop; this one never
  stops and wraps, so it suits the axes that are a loop (VFX_AXIS_ANGLE,
  VFX_AXIS_SPIRAL) as well as the ones that are a line.

  Its position comes from the clock rather than being accumulated, so the two
  halves of a split stay in step with nothing exchanged and a dropped frame
  does not shift it.

compatible: "zmk,vfx-layer-comet"

include: vfx-layer-common.yaml

properties:
  color:
    type: int
    required: true
    description: The tail, built with VFX_HSB(h, s, b).

  head-color:
    type: int
    default: 0
    description: |
      The leading pixel. 0 uses `color` at full brightness. A pale head
      against a saturated tail is what gives it direction.

  period-ms:
    type: int
    default: 3000
    description: Milliseconds for one lap of the axis.

  tail:
    type: int
    default: 60
    description: |
      Axis units of trail behind the head: pixel-positions units for X, Y and
      RADIAL, 256ths of a turn for ANGLE and SPIRAL, strip positions otherwise.

  count:
    type: int
    default: 1
    description: |
      How many comets, spread evenly around the lap. Two opposite each other
      on an angular axis is the classic dual beacon.

  axis:
    type: int
    default: 0
    description: |
      Which way it runs, as a VFX_AXIS_* value. VFX_AXIS_ANGLE sends it round
      the board; the default runs it along the strip.
```

## dts/bindings/zmk,vfx-layer-cross.yaml
```yaml
# Copyright (c) 2026 The ZMK VFX Contributors
# SPDX-License-Identifier: MIT

description: |
  A keypress lights the row and column the key sits in, which then fade.

  Where ripple asks how far a pixel is from the key, this asks whether it is
  in line with it, so the reaction traces the board's grid instead of ignoring
  it. Three familiar shapes come out of the same generator:

    - the full cross: both arms, radius 0;
    - a band across the board: axes = <VFX_CROSS_HORIZONTAL>;
    - a short cross around the key, which other keyboards call a nexus: set a
      radius, and the arms fade out over it.

  It needs pixel-positions to know what a row and a column are. Without a map
  it lights a run of the strip either side of the key, which is as close to
  "in line with it" as strip order gets.

compatible: "zmk,vfx-layer-cross"

include: vfx-layer-common.yaml

properties:
  color:
    type: int
    required: true
    description: The arms, built with VFX_HSB(h, s, b).

  centre-color:
    type: int
    default: 0
    description: |
      The pressed key itself. 0 uses `color` throughout. A brighter middle is
      what makes the shape read as coming from the key rather than as two
      lines that happen to meet.

  decay-ms:
    type: int
    default: 500
    description: Milliseconds for one cross to fade out.

  radius:
    type: int
    default: 0
    description: |
      How far the arms reach, in pixel-positions units. 0 runs them to the
      edge of the board at full brightness. Any other value fades them out
      over that distance, which is the nexus shape.

  thickness:
    type: int
    default: 4
    description: |
      Units either side of the arm's line that still count as on it. It wants
      to be under half your LED pitch, or neighbouring rows join in; the
      shipped maps use about 10 per LED, so 4 is a row and no more.

  axes:
    type: int
    default: 0
    description: |
      VFX_CROSS_BOTH (the default), VFX_CROSS_HORIZONTAL for the row only, or
      VFX_CROSS_VERTICAL for the column only.
```
