## Kconfig
```kconfig
# Copyright (c) 2026 The ZMK VFX Contributors
# SPDX-License-Identifier: MIT

menuconfig ZMK_VFX
    bool "Advanced addressable underglow effects (VFX)"
    select LED_STRIP
    help
      Replaces ZMK's built-in RGB underglow with a devicetree-configurable
      compositor: scenes are stacks of effect layers, each scoped to a pixel
      zone and combined with a blend mode.

      This owns the strip referenced by the "zmk,underglow" chosen node, so
      CONFIG_ZMK_RGB_UNDERGLOW must be disabled.

if ZMK_VFX

config ZMK_VFX_FPS
    int "Target frames per second"
    range 1 120
    default 50
    help
      Upper bound on the render rate. The engine renders no faster than this
      and may render slower when the active scene is static.

config ZMK_VFX_BRT_MAX
    int "Maximum global brightness in percent"
    range 1 100
    default 100
    help
      Hard ceiling applied after compositing. Lower this to cap current draw.

config ZMK_VFX_BRT_START
    int "Startup global brightness in percent"
    range 0 100
    default 60

config ZMK_VFX_SPD_START
    int "Startup animation speed"
    range 1 5
    default 3

config ZMK_VFX_ON_START
    bool "Underglow starts on"
    default y

config ZMK_VFX_GAMMA
    bool "Apply perceptual (CIE 1931) gamma correction"
    default y
    help
      Maps composited linear values through a CIE 1931 lightness curve so
      brightness ramps look even to the eye. Costs 256 bytes of flash.

config ZMK_VFX_AUTO_POWER_GATE
    bool "Cut power to the LEDs when every pixel is off"
    default y
    help
      WS2812s draw close to 1 mA each even while displaying black, so a 36
      pixel strip sits around 30 mA whether or not anything is lit. When a
      rendered frame comes out entirely black this switches the external
      power rail off, and switches it back on as soon as a frame has
      something to show.

      The engine keeps rendering while gated, which costs almost nothing
      without the bus transfer, so a keypress ripple still wakes the strip.

      Requires a zmk,ext-power-generic node. Note that on many boards that
      rail feeds everything external, not just the LEDs: if a display shares
      it, the display will switch off too.

config ZMK_VFX_BLACKOUT_DELAY_MS
    int "Milliseconds of continuous black before cutting the rail"
    depends on ZMK_VFX_AUTO_POWER_GATE
    range 0 60000
    default 500
    help
      Stops a scene that blinks, or one that dips through black between
      cycles, from switching the rail on and off continuously.

config ZMK_VFX_POWER_SETTLE_MS
    int "Milliseconds to let the rail stabilise before the first frame"
    depends on ZMK_VFX_AUTO_POWER_GATE
    range 0 1000
    default 50
    help
      Driving data at a strip whose supply has not come up yet shows as
      garbage on the first few pixels. The default matches the init-delay-ms
      the nice_nano board uses for the same rail.

config ZMK_VFX_SUSPEND_STRIP_BUS
    bool "Suspend the LED strip's bus while the rail is gated"
    depends on ZMK_VFX_AUTO_POWER_GATE && PM_DEVICE
    default y
    help
      Applies the bus node's sleep pinctrl state, parking the data line low.
      A data pin left high into an unpowered strip leaks current through the
      chip's protection diode, which would undo much of the saving.

config ZMK_VFX_SKIP_UNCHANGED_FRAMES
    bool "Skip the bus transfer when a frame is identical to the last"
    default y
    help
      Saves the SPI transfer and its DMA activity on static or slow scenes
      even while the strip is lit.

choice ZMK_VFX_SPLIT_MODE
    prompt "How the halves of a split agree on an animation"
    default ZMK_VFX_SPLIT_FREE
    depends on ZMK_SPLIT

config ZMK_VFX_SPLIT_FREE
    bool "Free-running"
    help
      Each half renders its own slice of one whole-board coordinate space
      from its own clock. Effects are written so that two halves agreeing on
      the time produce identical frames, so gradients and waves line up
      across the seam with no radio traffic at all.

      What the halves do not share is a clock, so over hours of uptime two
      crystals drift apart and the seam gradually loses alignment. Reactive
      effects respond only to the keys their own half can see.

config ZMK_VFX_SPLIT_SYNCED
    bool "Synchronised over the split link"
    help
      The central periodically tells the peripheral what time it thinks it
      is, and relays its own key positions, so the halves stay aligned
      indefinitely and a ripple started on one side crosses to the other.

      Uses ZMK's existing behavior relay rather than a separate GATT
      service. Corrections are eased in rather than stepped, so they are not
      visible in whatever is on screen.

      Costs a little radio traffic and therefore a little battery.

endchoice

config ZMK_VFX_SYNC_INTERVAL_MS
    int "Milliseconds between synchronisation beacons"
    depends on ZMK_VFX_SPLIT_SYNCED
    range 200 60000
    default 2000
    help
      Lower keeps the halves tighter at the cost of more radio traffic.
      Crystal drift is parts per million, so seconds between beacons is
      plenty once the initial offset has been established.

config ZMK_VFX_SYNC_RELAY_KEYS
    bool "Relay the central's key positions to the peripheral"
    depends on ZMK_VFX_SPLIT_SYNCED
    default y
    help
      Lets a ripple started by a key on the central half continue onto the
      peripheral. Without it each half only reacts to its own keys.

      This sends a message per keypress on the central half, which is the
      most expensive part of synced mode.

config ZMK_VFX_RGB_UNDERGLOW_COMPAT
    bool "Bind &rgb_ug to the VFX engine"
    default y
    help
      ZMK always declares the rgb_ug behavior node, but only compiles its
      driver under CONFIG_ZMK_RGB_UNDERGLOW, which VFX requires to be off.
      Without this shim a keymap that uses &rgb_ug will not build.

      RGB_EFF and RGB_EFR cycle scenes, brightness, speed and hue map onto
      their engine equivalents, and the saturation commands are accepted but
      ignored: VFX sets saturation per layer in devicetree rather than
      globally.

config ZMK_VFX_INDICATORS
    bool "Feed keyboard state to the indicator layers"
    default y
    help
      Subscribes to layer, battery, Bluetooth profile and caps word events
      and makes them available to the zmk,vfx-layer-layer-state,
      -battery, -ble-profile and -caps-word generators.

      Turn off to drop those subscriptions if no scene uses them.

config ZMK_VFX_AUTO_OFF_IDLE
    bool "Turn underglow off when the keyboard goes idle"
    default y

config ZMK_VFX_RAW_HID
    bool "Drive per-layer tuning from a host over raw HID"
    depends on RAW_HID
    help
      Decodes zzeneg/zmk-raw-hid reports into zmk_vfx_tune_*() calls and
      replies over the same transport, so a companion app can move a
      layer's hue, level or speed live rather than only from the keymap.

      RAW_HID is a separate module: add it to west.yml and the
      raw_hid_adapter shield to your build before turning this on. See the
      README for the wire format.

config ZMK_VFX_RUNTIME_SCENES
    bool "Build a channel's scene at runtime rather than only in devicetree"
    help
      Adds zmk_vfx_scene_*(): add, edit, remove and reorder layers in a
      bounded per-channel pool, and switch a channel to showing it instead
      of its compiled list. Persisted the same way tuning is.

      Every generator is buildable this way. A layer too big for one
      message is assembled from several: the generator and its first colour
      and four arguments in one, then more arguments, more colours, the zone
      and the layer's options each in a message of their own -- see
      runtime_scene.h and the README. Costs RAM on every board that turns it
      on, sized by the options below, whether or not anything is ever built
      at runtime.

      Nothing drives this by itself: it needs a transport, and
      CONFIG_ZMK_VFX_RAW_HID is the only one today. That transport is
      central-only on a split, so turn this on for every half, not just the
      one running raw-hid -- an edit relays to the others (see the README),
      and a half without this cannot apply what arrives.

if ZMK_VFX_RUNTIME_SCENES

config ZMK_VFX_RUNTIME_MAX_LAYERS
    int "Layers a channel's runtime scene pool holds at once"
    range 1 16
    default 6
    help
      Sized per channel, not shared across them: a board with two channels
      each turning this on costs twice this many layers' worth of RAM.

config ZMK_VFX_RUNTIME_MAX_COLORS
    int "Colours in a runtime layer's colour list"
    range 3 16
    default 8
    help
      The colour list holds a gradient's stops, the second colour of the
      generators that draw with two, and a layer-state layer's colour per
      keymap layer. At least 3, which is what peripheral-battery needs.

      Persisted with every layer, so it also sizes the saved blob: it has to
      fit one flash sector, which raising this, the layer count or the zone
      size too far will stop it doing.

config ZMK_VFX_RUNTIME_MAX_ZONE_PIXELS
    int "Entries in a runtime layer's pixel or key list"
    range 4 128
    default 32
    help
      How many strip indices or key positions one layer's zone can list,
      when it is not a plain range. Sized per layer and persisted with it.

config ZMK_VFX_RUNTIME_HEAVY_STATES
    int "Trail and hold layers a channel's runtime scene can hold at once"
    range 1 8
    default 2
    help
      Trail and hold keep a byte of animation state for every pixel, which
      would be wasted on every other layer if each slot carried it. They
      draw from this pool instead, per channel; adding one when it is empty
      is refused with the same POOL_FULL a full layer pool gives.

config ZMK_VFX_RUNTIME_SCENES_PER_CHANNEL
    int "Runtime scenes each channel can hold"
    range 1 8
    default 1
    help
      Each channel gets this many runtime scenes, each a full pool of its own
      and each saved as its own settings entry. NEXT and PREV walk through the
      non-empty ones after the compiled list. More scenes cost RAM and flash
      in proportion to RUNTIME_MAX_LAYERS and the other limits above; the
      build fails if the saved scenes would outgrow their share of the
      settings partition.

config ZMK_VFX_SPLIT_LINK_QUEUE_CHUNKS
    int "Relay chunks the central queues for its peripherals"
    range 8 512
    default 48
    help
      A runtime-scene edit crosses the split as chunks of four bytes, one &vfx
      behavior invocation each; a layer is a few of them, a whole scene resync
      many more. The central holds them here and sends them at a steady pace
      rather than all at once, and refuses a request (the host sees BUSY) when
      this cannot take all of it, rather than let ZMK's own queue drop part of
      one. Eight bytes of RAM per chunk. 48 holds nine of the longest
      requests.

config ZMK_VFX_SPLIT_LINK_CHUNK_INTERVAL_MS
    int "Milliseconds between relay chunks"
    range 1 200
    default 16
    help
      How often the central hands one chunk to ZMK's split transport. Too low
      and ZMK's own queue overflows (chunks are lost, which the peripheral
      notices and the central repairs, but slowly); too high and a big edit
      takes visibly long. 16 is a first guess, not a measurement: the README's
      "Verifying on hardware" has the stress test that finds the smallest value
      that loses nothing on your boards. Below about 12 ms a full ZMK queue
      can stall the central for up to 100 ms per call.

config ZMK_VFX_SPLIT_LINK_STATS
    bool "Log relay losses"
    help
      Logs a warning whenever a half drops, abandons or refuses a relayed
      message, with running totals. For measuring the link; leave it off once
      the pacing is settled.

config ZMK_VFX_SPLIT_REPORT
    bool "Peripheral report channel (experimental)"
    depends on ZMK_SPLIT_BLE
    select BT_GATT_CLIENT if ZMK_SPLIT_ROLE_CENTRAL
    help
      Lets a peripheral tell the central whether its copy of each runtime scene
      matches, over a small GATT service of its own that the central subscribes
      to on every split connection. With it the central can check the halves
      after each edit and rebuild a peripheral that drifted, and the Host panel
      shows each half's state. Without it the link is one way: the halves
      cannot tell the central anything: SCENE_VERIFY only makes a peripheral log
      the result, there is no automatic repair and a rebuild has to be asked for
      with SCENE_RESYNC.

      Experimental until it has been run on hardware. The central discovers the
      service on its own after ZMK has finished its own discovery, retrying
      while ZMK still holds the connection; the risk is that this disturbs
      ZMK's own peripheral connection or battery reporting, which the README's
      "Verifying on hardware" checklist covers. Enable it on both halves.

config ZMK_VFX_SPLIT_AUTO_RESYNC
    bool "Rebuild a peripheral automatically when its scene does not match"
    default y
    depends on ZMK_VFX_SPLIT_REPORT
    help
      A mismatch report makes the central replay that scene to the peripherals.
      Tried twice per scene per edit, then left for a manual resync, so two
      builds that disagree about what a scene hashes to cannot loop.

config ZMK_VFX_SPLIT_CHECK_DEBOUNCE_MS
    int "Quiet time after an edit before the halves are compared"
    range 50 5000
    default 400
    depends on ZMK_VFX_SPLIT_REPORT || ZMK_VFX_SPLIT_LINK_STATS
    help
      The central sends one hash CHECK per edited scene once edits have paused
      for this long, rather than one per edit.

endif # ZMK_VFX_RUNTIME_SCENES

module = ZMK_VFX
module-str = zmk_vfx
source "subsys/logging/Kconfig.template.log_config"

endif # ZMK_VFX
```

## dts/bindings/behaviors/zmk,behavior-vfx.yaml
```yaml
# Copyright (c) 2026 The ZMK VFX Contributors
# SPDX-License-Identifier: MIT

description: Advanced underglow (VFX) control

compatible: "zmk,behavior-vfx"

include: two_param.yaml
```
